## examples/sdkconfig.defaults
```kconfig
CONFIG_LWIP_IPV6=y
CONFIG_ENABLE_MDNS=y
CONFIG_MDNS_MAX_SERVICES=1
CONFIG_PARTITION_TABLE_TWO_OTA=y
CONFIG_PARTITION_TABLE_FILENAME="partitions_two_ota.csv"
CONFIG_ESPTOOLPY_FLASHSIZE_4MB=y
```
